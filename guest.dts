/dts-v1/;

/ {
	#address-cells = <1>;
	#size-cells = <1>;
	model = "test";
	compatible = "test";

	chosen {
		stdout-path = "serial0:115200n8";
		bootargs = "earlycon=sbi console=ttyS0,115200";
	};

	memory@80000000 {
		device_type = "memory";
		reg = <0x70000000 0x400000>; /* Just 4MiB */
	};

/*
	uart0: uart@dead0000 {
		compatible = "ns16550a";
		reg = <0xdead0000 0x100>;
		clock-frequency = "\08@";
		interrupt-parent = <0x03>;
		interrupts = <1>;
	};

	cpus {
		#address-cells = <1>;
		#size-cells = <0>;

		cpu0: cpu@0 {
			phandle = <0x01>;
			device_type = "cpu";
			reg = <0>;
			status = "okay";
			compatible = "riscv";
			riscv,isa = "rv64imafdcsuh";
			mmu-type = "riscv,sv39";

			cpu0_intc: interrupt-controller {
				#address-cells = <1>;
				#interrupt-cells = <1>;
				interrupt-controller;
				compatible = "riscv,cpu-intc";
				phandle = <0x02>;
			};
		};
	};

	plic@f8000000 {
		#interrupt-cells = <0x01>;
		#address-cells = <1>;

		compatible = "sifive,plic-1.0.0\0riscv,plic0";
		riscv,ndev = <0x35>;
		phandle = <0x03>;
		reg = <0xf8000000 0x600000>;
		interrupts-extended = <&cpu0_intc 1>;
		interrupt-controller;
	};
*/
};
